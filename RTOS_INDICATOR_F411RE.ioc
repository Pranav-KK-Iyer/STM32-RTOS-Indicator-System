# file: RTOS_INDICATOR_F411RE.ioc
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FREERTOS.Tasks01=IndicatorTask,24,128,StartIndicatorTask,Default,NULL,Dynamic,NULL,NULL;ButtonTask,40,128,StartButtonTask,Default,NULL,Dynamic,NULL,NULL;LEDTask,24,128,StartLEDTask,Default,NULL,Dynamic,NULL,NULL
Mcu.Family=STM32F4
Mcu.Name=STM32F411R(C-E)Tx
Mcu.Package=LQFP64
NVIC.PriorityGroup=NVIC_PRIORITYGROUP_4
PA2.Signal=USART2_TX
PA3.Signal=USART2_RX
PA5.Signal=GPIO_Output
ProjectManager.HeapSize=0x200
ProjectManager.StackSize=0x400
ProjectManager.TargetToolchain=STM32CubeIDE
RCC.AHBFreq_Value=16000000
RCC.APB1Freq_Value=16000000
RCC.APB2Freq_Value=16000000
RCC.CortexFreq_Value=16000000
RCC.HSE_VALUE=25000000
RCC.HSI_VALUE=16000000
RCC.LSE_VALUE=32768
RCC.SYSCLKFreq_VALUE=16000000
RCC.VCOOutputFreq_Value=192000000
VP_FREERTOS_VS_CMSIS_V2.Mode=CMSIS_V2
board=custom

// file: Core/Src/main.c
/* USER CODE BEGIN Header */
/**
  ******************************************************************************
  * @file           : main.c
  * @brief          : Main program body
  ******************************************************************************
  * @attention
  *
  * Copyright (c) 2026 STMicroelectronics.
  * All rights reserved.
  *
  * This software is licensed under terms that can be found in the LICENSE file
  * in the root directory of this software component.
  * If no LICENSE file comes with this software, it is provided AS-IS.
  *
  ******************************************************************************
  */
/* USER CODE END Header */
#include "main.h"
#include "cmsis_os.h"

/* USER CODE BEGIN Includes */
#include <stdio.h>
/* USER CODE END Includes */

/* USER CODE BEGIN PTD */
typedef enum {
    EVT_LEFT,
    EVT_RIGHT,
    EVT_BOTH,
    EVT_NONE
} Event_t;

/* USER CODE END PTD */

/* Definitions for IndicatorTask */
osThreadId_t IndicatorTaskHandle;
const osThreadAttr_t IndicatorTask_attributes = {
  .name = "IndicatorTask",
  .stack_size = 128 * 4,
  .priority = (osPriority_t) osPriorityNormal,
};
/* Definitions for ButtonTask */
osThreadId_t ButtonTaskHandle;
const osThreadAttr_t ButtonTask_attributes = {
  .name = "ButtonTask",
  .stack_size = 128 * 4,
  .priority = (osPriority_t) osPriorityHigh,
};
/* Definitions for LEDTask */
osThreadId_t LEDTaskHandle;
const osThreadAttr_t LEDTask_attributes = {
  .name = "LEDTask",
  .stack_size = 128 * 4,
  .priority = (osPriority_t) osPriorityNormal,
};
/* USER CODE BEGIN PV */

typedef enum {
    STATE_IDLE,
    STATE_LEFT,
    STATE_RIGHT,
    STATE_HAZARD
} State_t;

State_t currentState = STATE_IDLE;

osMessageQueueId_t eventQueue;

/* USER CODE END PV */

void SystemClock_Config(void);
static void MX_GPIO_Init(void);
void StartIndicatorTask(void *argument);
void StartButtonTask(void *argument);
void StartLEDTask(void *argument);

int main(void)
{

  /* MCU Configuration--------------------------------------------------------*/

  /* Reset of all peripherals, Initializes the Flash interface and the Systick. */
  HAL_Init();

  /* Configure the system clock */
  SystemClock_Config();

  /* Initialize all configured peripherals */
  MX_GPIO_Init();
  /* USER CODE BEGIN 2 */
  eventQueue = osMessageQueueNew(10, sizeof(Event_t), NULL);
  if(eventQueue == NULL)
  {
      Error_Handler();
  }

  /* USER CODE END 2 */

  /* Init scheduler */
  osKernelInitialize();

  /* Create the thread(s) */
  /* creation of IndicatorTask */
  IndicatorTaskHandle = osThreadNew(StartIndicatorTask, NULL, &IndicatorTask_attributes);

  /* creation of ButtonTask */
  ButtonTaskHandle = osThreadNew(StartButtonTask, NULL, &ButtonTask_attributes);

  /* creation of LEDTask */
  LEDTaskHandle = osThreadNew(StartLEDTask, NULL, &LEDTask_attributes);

  /* Start scheduler */
  osKernelStart();

  /* We should never get here as control is now taken by the scheduler */

  /* Infinite loop */
  while (1)
  {

  }
}

void SystemClock_Config(void)
{
  RCC_OscInitTypeDef RCC_OscInitStruct = {0};
  RCC_ClkInitTypeDef RCC_ClkInitStruct = {0};

  /** Configure the main internal regulator output voltage
  */
  __HAL_RCC_PWR_CLK_ENABLE();
  __HAL_PWR_VOLTAGESCALING_CONFIG(PWR_REGULATOR_VOLTAGE_SCALE1);

  /** Initializes the RCC Oscillators according to the specified parameters
  * in the RCC_OscInitTypeDef structure.
  */
  RCC_OscInitStruct.OscillatorType = RCC_OSCILLATORTYPE_HSI;
  RCC_OscInitStruct.HSIState = RCC_HSI_ON;
  RCC_OscInitStruct.HSICalibrationValue = RCC_HSICALIBRATION_DEFAULT;
  RCC_OscInitStruct.PLL.PLLState = RCC_PLL_NONE;
  if (HAL_RCC_OscConfig(&RCC_OscInitStruct) != HAL_OK)
  {
    Error_Handler();
  }

  /** Initializes the CPU, AHB and APB buses clocks
  */
  RCC_ClkInitStruct.ClockType = RCC_CLOCKTYPE_HCLK|RCC_CLOCKTYPE_SYSCLK
                              |RCC_CLOCKTYPE_PCLK1|RCC_CLOCKTYPE_PCLK2;
  RCC_ClkInitStruct.SYSCLKSource = RCC_SYSCLKSOURCE_HSI;
  RCC_ClkInitStruct.AHBCLKDivider = RCC_SYSCLK_DIV1;
  RCC_ClkInitStruct.APB1CLKDivider = RCC_HCLK_DIV1;
  RCC_ClkInitStruct.APB2CLKDivider = RCC_HCLK_DIV1;

  if (HAL_RCC_ClockConfig(&RCC_ClkInitStruct, FLASH_LATENCY_0) != HAL_OK)
  {
    Error_Handler();
  }
}

static void MX_GPIO_Init(void)
{
  GPIO_InitTypeDef GPIO_InitStruct = {0};

  /* GPIO Ports Clock Enable */
  __HAL_RCC_GPIOA_CLK_ENABLE();

  /*Configure GPIO pin Output Level */
  HAL_GPIO_WritePin(GPIOA, GPIO_PIN_5, GPIO_PIN_RESET);

  /*Configure GPIO pins : PA2 PA3 */
  GPIO_InitStruct.Pin = GPIO_PIN_2|GPIO_PIN_3;
  GPIO_InitStruct.Mode = GPIO_MODE_AF_PP;
  GPIO_InitStruct.Pull = GPIO_NOPULL;
  GPIO_InitStruct.Speed = GPIO_SPEED_FREQ_VERY_HIGH;
  GPIO_InitStruct.Alternate = GPIO_AF7_USART2;
  HAL_GPIO_Init(GPIOA, &GPIO_InitStruct);

  /*Configure GPIO pin : PA5 */
  GPIO_InitStruct.Pin = GPIO_PIN_5;
  GPIO_InitStruct.Mode = GPIO_MODE_OUTPUT_PP;
  GPIO_InitStruct.Pull = GPIO_NOPULL;
  GPIO_InitStruct.Speed = GPIO_SPEED_FREQ_LOW;
  HAL_GPIO_Init(GPIOA, &GPIO_InitStruct);

  /* USER CODE BEGIN MX_GPIO_Init_2 */
  GPIO_InitStruct.Pin = GPIO_PIN_0 | GPIO_PIN_1;
  GPIO_InitStruct.Mode = GPIO_MODE_INPUT;
  GPIO_InitStruct.Pull = GPIO_PULLUP;
  HAL_GPIO_Init(GPIOC, &GPIO_InitStruct);

  /* USER CODE END MX_GPIO_Init_2 */
}

void StartIndicatorTask(void *argument)
{
  /* USER CODE BEGIN 5 */
	Event_t evt;
  /* Infinite loop */
  for(;;)
  {
	  if(osMessageQueueGet(eventQueue, &evt, NULL, 100) == osOK)
	          {
		  	  switch(currentState)
		  	  {
		      case STATE_IDLE:
		          if(evt == EVT_LEFT) currentState = STATE_LEFT;
		          else if(evt == EVT_RIGHT) currentState = STATE_RIGHT;
		          else if(evt == EVT_BOTH) currentState = STATE_HAZARD;
		          break;

		      case STATE_LEFT:
		          if(evt == EVT_LEFT) currentState = STATE_IDLE;
		          else if(evt == EVT_RIGHT) currentState = STATE_RIGHT;
		          else if(evt == EVT_BOTH) currentState = STATE_HAZARD;
		          break;

		      case STATE_RIGHT:
		          if(evt == EVT_RIGHT) currentState = STATE_IDLE;
		          else if(evt == EVT_LEFT) currentState = STATE_LEFT;
		          else if(evt == EVT_BOTH) currentState = STATE_HAZARD;
		          break;

		      case STATE_HAZARD:
		          if(evt == EVT_LEFT || evt == EVT_RIGHT)
		              currentState = STATE_IDLE;
		          break;
		  	  }
	          }

	          osDelay(50);

  }
  /* USER CODE END 5 */
}

void StartButtonTask(void *argument)
{
  /* USER CODE BEGIN StartButtonTask */
	Event_t evt;
	uint32_t left_press_time = 0;
	uint32_t right_press_time = 0;

	// persists across loop iterations
	static uint8_t hazard_sent = 0;
  /* Infinite loop */
  for(;;)
  {
	  int left = HAL_GPIO_ReadPin(GPIOC, GPIO_PIN_0);
	      int right = HAL_GPIO_ReadPin(GPIOC, GPIO_PIN_1);

	      // HAZARD FIRST (highest priority)
	      if(left == GPIO_PIN_RESET && right == GPIO_PIN_RESET)
	      {
	        if(!hazard_sent)
	        {
	          evt = EVT_BOTH;
	          osMessageQueuePut(eventQueue, &evt, 0, 0);
	          hazard_sent = 1;
	        }

	        // reset individual timers
	        left_press_time = 0;
	        right_press_time = 0;
	      }
	      else
	      {
	        hazard_sent = 0;

	        // LEFT BUTTON
	        if(left == GPIO_PIN_RESET)
	        {
	          left_press_time += 100;
	          if(left_press_time >= 1000)
	          {
	            evt = EVT_LEFT;
	            osMessageQueuePut(eventQueue, &evt, 0, 0);
	            left_press_time = 0;
	          }
	        }
	        else
	        {
	          left_press_time = 0;
	        }

	        // RIGHT BUTTON
	        if(right == GPIO_PIN_RESET)
	        {
	          right_press_time += 100;
	          if(right_press_time >= 1000)
	          {
	            evt = EVT_RIGHT;
	            osMessageQueuePut(eventQueue, &evt, 0, 0);
	            right_press_time = 0;
	          }
	        }
	        else
	        {
	          right_press_time = 0;
	        }
	      }

    osDelay(100);
  }
  /* USER CODE END StartButtonTask */
}

void StartLEDTask(void *argument)
{
  /* USER CODE BEGIN StartLEDTask */
  /* Infinite loop */
  for(;;)
  {
	  switch(currentState)
	      {
	          case STATE_LEFT:
	              HAL_GPIO_TogglePin(GPIOA, GPIO_PIN_5);
	              osDelay(500);   // slower blink
	              break;

	          case STATE_RIGHT:
	              HAL_GPIO_TogglePin(GPIOA, GPIO_PIN_5);
	              osDelay(500);   // same as left
	              break;

	          case STATE_HAZARD:
	              HAL_GPIO_TogglePin(GPIOA, GPIO_PIN_5);
	              osDelay(200);   // faster blink
	              break;

	          default:
	              HAL_GPIO_WritePin(GPIOA, GPIO_PIN_5, GPIO_PIN_RESET);
	              osDelay(100);
	              break;
	      }

  }
  /* USER CODE END StartLEDTask */
}

void Error_Handler(void)
{
  __disable_irq();
  while (1)
  {
  }
}
